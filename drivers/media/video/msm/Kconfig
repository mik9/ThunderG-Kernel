## drivers/media/video/msm/Kconfig
```kconfig
comment "Camera Sensor Selection"
config MT9T013
	bool "Sensor mt9t013 (BAYER 3M)"
	depends on MSM_CAMERA && !ARCH_MSM8X60
	default y
	---help---
	  MICRON 3M Bayer Sensor with AutoFocus

#LGE_CHANGES_S [junyeong.han@lge.com] 2010-01-14, [SWIFT] add configuration for isx005 sensor
config ISX005
	bool "Sensor isx005 (YUV 3M)"
	depends on MSM_CAMERA
	default y
	---help---
	  SONY 3M YUV Sensor with AutoFocus
#LGE_CHANGES_E [junyeong.han@lge.com] 2010-01-14, [SWIFT]
#LGE_CHANGES_S [eunyoung.shin@lge.com] 2010-09-17 
config ISX005_VDF
	bool "VDF Camera tuning"
	depends on MSM_CAMERA
	default y
	---help---
          VDF Camera Tuning value
#LGE_CHANGES_E [eunyoung.sin@lge.com] 2010-09-17

if ISX005
config ISX005_ROTATION_180
	bool "Display rotation of an angle of 180 degrees"
	default n
	---help---
	  Rotate display to an angle of 180 degrees.
endif

config MT9D112
	bool "Sensor mt9d112 (YUV 2M)"
	depends on MSM_CAMERA && !ARCH_MSM8X60
	default y
	---help---
	  MICRON 2M YUV Sensor
config IMX074
	bool "Sensor IMX074 (BAYER 13.5M)"
	depends on MSM_CAMERA && ARCH_MSM8X60
	default y
	---help---
	SONY 13.5 MP Bayer Sensor
config VX6953
	bool "Sensor VX6953 (BAYER 5M)"
	depends on MSM_CAMERA && ARCH_MSM7X30
	default y
	---help---
	STM 5M Bayer Sensor with EDOF

config MT9P012
	bool "Sensor mt9p012 (BAYER 5M)"
	depends on MSM_CAMERA && !ARCH_MSM8X60
	default y
	---help---
	  MICRON 5M Bayer Sensor with Autofocus

choice
	prompt "AF module"
	depends on MT9P012 && !ARCH_MSM8X60
	default MSM_CAMERA_AF_FOXCONN

config MSM_CAMERA_AF_FOXCONN
	bool "FOXCONN Module"
	help
	  This driver supports FOXCONN AF module for 5M Bayer sensor

config MSM_CAMERA_AF_BAM
	bool "BAM Module"
	help
	  This driver supports BAM AF module for 5M Bayer sensor

endchoice

config MT9P012_KM
	bool "Sensor mt9p012 KM module (BAYER 5M)"
	depends on MSM_CAMERA && !ARCH_MSM8X60
	default y
	---help---
	  MICRON 5M Bayer Sensor KM modules with Autofocus

config S5K3E2FX
	bool "Sensor s5k3e2fx (Samsung 5M)"
	depends on MSM_CAMERA && !ARCH_MSM8X60
	default y
	---help---
	  Samsung 5M with Autofocus

config VB6801
	bool "Sensor vb6801"
	depends on MSM_CAMERA && !ARCH_MSM8X60
	---help---
	  5M with flash

config MSM_CAMERA_FLASH
	bool "Qualcomm MSM camera flash support"
	depends on MSM_CAMERA && !ARCH_MSM8X60
	default y
	---help---
	  Enable support for LED flash for msm camera

config MSM_GEMINI
	tristate "Qualcomm MSM Gemini Jpeg Engine support"
	depends on MSM_CAMERA
	default M
	---help---
	  Enable support for Gemini Jpeg Engine
```
